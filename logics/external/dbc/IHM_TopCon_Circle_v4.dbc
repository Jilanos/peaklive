VERSION ""

NS_ :

BS_:

BU_:

BO_ 119 Ecran1: 8 Vector__XXX
 SG_ Ignition_Status : 7|1@1+ (1,0) [0|1] "" Vector__XXX
 SG_ AlertDrive : 4|1@1+ (1,0) [0|1] "" Vector__XXX
 SG_ ClignotantsDroit : 15|1@1+ (1,0) [0|1] "" Vector__XXX
 SG_ ClignotantGauche : 14|1@1+ (1,0) [0|1] "" Vector__XXX
 SG_ Autonomie_Restante : 16|8@1+ (1,0) [0|255] "km" Vector__XXX
 SG_ Compteur_Kilometrique : 40|17@1+ (1,0) [0|131071] "km" Vector__XXX
 SG_ Vitesse : 32|8@1+ (1,0) [0|255] "km/h" Vector__XXX
 SG_ Soc_Batterie : 24|8@1+ (1,0) [0|255] "%" Vector__XXX
 SG_ Defaut_Batterie : 10|2@1+ (1,0) [0|3] "" Vector__XXX
 SG_ Driving_Mode : 12|2@1+ (1,0) [0|3] "" Vector__XXX
 SG_ Etat_Moteur : 8|2@1+ (1,0) [0|3] "" Vector__XXX
 SG_ Mode_Degrade : 1|1@1+ (1,0) [0|1] "" Vector__XXX
 SG_ Parking_Brake : 2|1@1+ (1,0) [0|1] "" Vector__XXX
 SG_ Defaut_Frein : 3|1@1+ (1,0) [0|1] "" Vector__XXX
 SG_ Feux_Route : 5|1@1+ (1,0) [0|1] "" Vector__XXX
 SG_ Feux_Croisement : 6|1@1+ (1,0) [0|1] "" Vector__XXX
 SG_ Feux_Position : 0|1@1+ (1,0) [0|1] "" Vector__XXX

BA_DEF_  "BusType" STRING ;
BA_DEF_DEF_  "BusType" "CAN";
